## boards/shields/zherkin/Kconfig.defconfig
```kconfig
if SHIELD_ZHERKIN

config ZMK_USB
	default y

#config ZMK_ZHERKIN
#    default "Zherkin"
config ZMK_KEYBOARD_NAME
    default "Zherkin"
config SPI
	default y

endif
```

## boards/shields/zherkin/Kconfig.shield
```kconfig
# Copyright (c) 2020 Nick Winans
# SPDX-License-Identifier: MIT

# config SHIELD_NICE60
config SHIELD_ZHERKIN
	def_bool $(shields_list_contains,zherkin)
```
